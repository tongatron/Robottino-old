/*
28 settembre 2014
ROBOTTINI @MakerFaire

max delay motore: 2-3
*/

#include <Wire.h>
#include <SeeedOLED.h>

const int buzzer = 11;

const int led_blue = 9;
const int led_green = 10;
const int led_red = 13;

#include <Servo.h>  
Servo servo;
int pos = 0;
const int slow = 4;
const int fast = 2;

int sensorValue;
int sensorLow = 1023;
int sensorHigh = 0;

static unsigned char Robottino_logo[] PROGMEM ={
0x00, 0x00, 0x00, 0x00, 0x00, 0x00, 0x00, 0x00, 0x00, 0x00, 0x00, 0x00, 0x00, 0x00, 0x00, 0x00,
0x00, 0x00, 0x00, 0x00, 0x00, 0x00, 0x00, 0x00, 0x00, 0x00, 0x00, 0x00, 0x00, 0x00, 0x00, 0x00,
0x00, 0x00, 0x00, 0x00, 0x00, 0x00, 0x00, 0x00, 0x00, 0x00, 0x00, 0x00, 0x00, 0x00, 0x00, 0x00,
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0x00, 0x00, 0x00, 0x00, 0x00, 0x00, 0x00, 0x00, 0x00, 0x00, 0x00, 0x00, 0x00, 0x00, 0x00, 0x00
};

static unsigned char mouth_zigzag[] PROGMEM ={
0x00, 0x00, 0x00, 0x00, 0x00, 0x00, 0x00, 0x00, 0x00, 0x00, 0x00, 0x00, 0x00, 0x00, 0x00, 0x00,
0x00, 0x00, 0x00, 0x00, 0x00, 0x00, 0x00, 0x00, 0x00, 0x00, 0x00, 0x00, 0x00, 0x00, 0x00, 0x00,
0x00, 0x00, 0x00, 0x00, 0x00, 0x00, 0x00, 0x00, 0x00, 0x00, 0x00, 0x00, 0x00, 0x00, 0x00, 0x00,
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0x00, 0x00, 0x00, 0x00, 0x00, 0x00, 0x00, 0x00, 0x00, 0x00, 0x00, 0x00, 0x00, 0x00, 0x00, 0x00
};

void setup() {
  
  servo.attach(8);
  servo.write(90);  
  
  Wire.begin();
  SeeedOled.init(); 
  SeeedOled.clearDisplay();
  SeeedOled.drawBitmap(Robottino_logo,1024);  
  
  pinMode(buzzer,OUTPUT);
  pinMode(led_blue, OUTPUT);
  pinMode(led_green, OUTPUT);
  pinMode(led_red, OUTPUT);
  ledoff();
  
  delay(4000);
}

void loop() {
  
  SeeedOled.clearDisplay();
  SeeedOled.drawBitmap(mouth_zigzag,1024);    
  ledoff();
  delay(1000);
  rotate();
  voice(); 
}

// **************************** ****************************  ****************************

void ledred(){
  digitalWrite(led_blue, LOW);
  digitalWrite(led_green, LOW);
  digitalWrite(led_red, HIGH);
}

void ledblue(){
  digitalWrite(led_blue, HIGH);
  digitalWrite(led_green, LOW);
  digitalWrite(led_red, LOW);
}

void ledgreen(){
  
  digitalWrite(led_blue, LOW);
  digitalWrite(led_green, LOW);
  digitalWrite(led_red, HIGH);
}

void ledoff(){
  digitalWrite(led_blue, LOW);
  digitalWrite(led_green, LOW);
  digitalWrite(led_red, LOW);  
}

// **************************** ****************************  ****************************

void voice(){
  ledblue();
  SeeedOled.clearDisplay();
  SeeedOled.drawBitmap(Robottino_logo,1024);
  delay(5000); 
}

// **************************** ****************************  ****************************

void rotate(){
  
  for(pos = 90; pos <= 130; pos += 1)  {
  ledred();    
  servo.write(pos);           
  delay(slow);                    
  } 
 
  for(pos = 130; pos>=40; pos-=1){
  ledblue();    
  servo.write(pos);         
  delay(fast);            
  }
 
  for(pos = 40; pos <= 80; pos += 1)  {
  ledred();
  servo.write(pos);           
  delay(slow);                    
  }
  
  for(pos = 80; pos <= 180; pos += 1)  {
  ledblue();    
  servo.write(pos);           
  delay(fast);                    
  }
 
  for(pos = 180; pos>=0; pos-=1){
  ledred();
  servo.write(pos);         
  delay(slow);            
  }
    
    
  for(pos = 0; pos <= 110; pos += 1)  {
  ledblue();    
  servo.write(pos);           
  delay(fast);                    
  } 
 
  for(pos = 110; pos>=0; pos-=1){  
  ledblue();    
  servo.write(pos);         
  delay(fast);            
  }
 
  for(pos = 0; pos <= 40; pos += 1)  {
  ledred();
  servo.write(pos);           
  delay(slow);                    
  }
  
  for(pos = 40; pos <= 150; pos += 1)  {  
  ledred();
  servo.write(pos);           
  delay(slow);                    
  }
 
  for(pos = 150; pos>=110; pos-=1){  
  ledblue();    
  servo.write(pos);         
  delay(fast);            
  }
  
  for(pos = 110; pos>=90; pos-=1){ 
  ledblue();    
  servo.write(pos);         
  delay(fast);            
  }  
  
  servo.write(90);
  delay(100);
}
