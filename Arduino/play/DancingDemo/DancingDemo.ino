/*
Giovanni Bindi
oct. 2014
*/
//display
#include <Wire.h>
#include <SeeedOLED.h>

//output
const int Buzzer = 11;
const int led_blue = 9;
const int led_green = 10;
const int led_red = 13;

//fade led
int brightness = 0;    // how bright the LED is
int fadeAmount = 5;    // how many points to fade the LED by

//servo
#include <Servo.h>  
Servo servo;
int pos = 0;
const int slow = 15;
const int fast = 3;


static unsigned char mouth_plane[] PROGMEM ={
0x00, 0x00, 0x00, 0x00, 0x00, 0x00, 0x00, 0x00, 0x00, 0x00, 0x00, 0x00, 0x00, 0x00, 0x00, 0x00,
0x00, 0x00, 0x00, 0x00, 0x00, 0x00, 0x00, 0x00, 0x00, 0x00, 0x00, 0x00, 0x00, 0x00, 0x00, 0x00,
0x00, 0x00, 0x00, 0x00, 0x00, 0x00, 0x00, 0x00, 0x00, 0x00, 0x00, 0x00, 0x00, 0x00, 0x00, 0x00,
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0x00, 0x00, 0x00, 0x00, 0x00, 0x00, 0x00, 0x00, 0x00, 0x00, 0x00, 0x00, 0x00, 0x00, 0x00, 0x00
};

static unsigned char mouth_smile[] PROGMEM ={
0xF0, 0xFC, 0xFE, 0xFE, 0xFF, 0xFF, 0xFF, 0xFF, 0xFF, 0xFF, 0xFF, 0xFF, 0xFF, 0xFF, 0xFF, 0xFF,
0xFF, 0xFF, 0xFF, 0xFF, 0xFF, 0xFF, 0xFF, 0xFF, 0xFF, 0xFF, 0xFF, 0xFF, 0xFF, 0xFF, 0xFF, 0xFF,
0xFF, 0xFF, 0xFF, 0xFF, 0xFF, 0xFF, 0xFF, 0xFF, 0xFF, 0xFF, 0xFF, 0xFF, 0xFF, 0xFF, 0xFF, 0xFF,
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0x00, 0x00, 0x00, 0x00, 0x00, 0x00, 0x00, 0x00, 0x00, 0x00, 0x00, 0x00, 0x00, 0x00, 0x00, 0x00
};


void setup() {
  
  //display
  Wire.begin();
  SeeedOled.init(); 
  SeeedOled.clearDisplay();
  SeeedOled.drawBitmap(mouth_plane,1024);  
  
  //output
  pinMode(Buzzer,OUTPUT);
  pinMode(led_blue, OUTPUT);
  pinMode(led_green, OUTPUT);
  pinMode(led_red, OUTPUT);
   

  ledblue();  
 
  //Servo
  servo.attach(8);
  servo.write(90);

}

void loop() {

  rotate();
  crazyhead();
  ledgreen();
  ledblue();
  SeeedOled.clearDisplay();
  SeeedOled.drawBitmap(mouth_plane,1024); 
  delay(15000);
}


// **************************** ****************************  ****************************

void rotate(){
  
  for(pos = 90; pos <= 180; pos += 1)  {
  servo.write(pos);           
  delay(slow);                    
  } 
 
  for(pos = 180; pos>=0; pos-=1){
  servo.write(pos);         
  delay(fast);            
  }
 
  for(pos = 0; pos <= 180; pos += 1)  {
  servo.write(pos);           
  delay(slow);                    
  }
  
  for(pos = 180; pos <= 90; pos += 1)  {
  servo.write(pos);           
  delay(slow);                    
  }
 
  
  servo.write(90);

}

// **************************** ****************************  ****************************
void crazyhead() {

  ledred();
  SeeedOled.clearDisplay();
  SeeedOled.drawBitmap(mouth_smile,1024);
  servo.write(90);
  delay(500);
 
  
  for (int i=0; i <= 90; i++){ 
    for(pos = 0; pos <= 180; pos += 1) // goes from 0 degrees to 180 degrees 
    {                                  // in steps of 1 degree 
      servo.write(pos);              // tell servo to g to position in variable 'pos' 
    } 
    for(pos = 180; pos>=0; pos-=1)     // goes from 180 degrees to 0 degrees 
    {                                
      servo.write(pos);              // tell servo to go to position in variable 'pos' 
    }
 }
 servo.write(90);
  
}


// **************************** ****************************  ****************************


void ledred(){
  digitalWrite(led_blue, LOW);
  digitalWrite(led_green, LOW);
  digitalWrite(led_red, HIGH);
}

void ledblue(){
  digitalWrite(led_blue, HIGH);
  digitalWrite(led_green, LOW);
  digitalWrite(led_red, LOW);  
}

void ledgreen(){
  digitalWrite(led_blue, LOW);
  digitalWrite(led_green, HIGH);
  digitalWrite(led_red, LOW);  
}

void ledoff(){
    digitalWrite(led_blue, LOW);
  digitalWrite(led_green, LOW);
  digitalWrite(led_red, LOW);  
}
