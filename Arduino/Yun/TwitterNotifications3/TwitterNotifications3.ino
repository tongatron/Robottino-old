/* https://www.temboo.com/arduino/yun/read-a-tweet

*/

#include <Bridge.h>
#include <Temboo.h>

int numRuns = 1;   // execution count, so this doesn't run forever
int maxRuns = 30;   // the max number of times the Twitter HomeTimeline Choreo should run

// to compare the tweets, 112 are the maximuc characters on the Oled
char tweetchar[112];
char tweetchar_old[112];

//servo
#include <Servo.h>  
Servo servo;
int pos = 0;
const int slow = 8;
const int fast = 2;

//output
const int buzzer = 11;
const int led_blue = 9;
const int led_green = 10;
const int led_red = 13;


//display
#include <Wire.h>
#include <SeeedOLED.h>
static unsigned char smile_display[] PROGMEM ={
0x00, 0x00, 0x00, 0x00, 0x00, 0x00, 0x00, 0x00, 0x00, 0x00, 0x00, 0x00, 0x00, 0x00, 0x00, 0x00,
0x00, 0x00, 0x00, 0x00, 0x00, 0x00, 0x00, 0x00, 0x00, 0x00, 0x00, 0x00, 0x00, 0x00, 0x00, 0x00,
0x00, 0x00, 0x00, 0x00, 0x00, 0x00, 0x00, 0x00, 0x00, 0x00, 0x00, 0x00, 0x00, 0x00, 0x00, 0x00,
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0x00, 0x00, 0x00, 0x00, 0x00, 0x00, 0x00, 0x00, 0x00, 0x00, 0x00, 0x00, 0x00, 0x00, 0x00, 0x00
};


void setup() {
  
  //output
  pinMode(buzzer,OUTPUT);
  pinMode(led_blue, OUTPUT);
  pinMode(led_green, OUTPUT);
  pinMode(led_red, OUTPUT);
  
  //display
  Wire.begin();
  SeeedOled.init(); 
  SeeedOled.clearDisplay();
  SeeedOled.drawBitmap(smile_display,1024); 

  ledred();
     
  //Serial.begin(9600);
  servo.attach(8);
  
  delay(1000);
  //while(!Serial);  // For debugging, wait until a serial console is connected.
  
  Bridge.begin();
  
  ledgreen();
  
}

void loop()
{
  
  SeeedOled.clearDisplay();
  SeeedOled.drawBitmap(smile_display,1024);
   
  
 // while we haven't reached the max number of runs...
  if (numRuns <= maxRuns) {
    //Serial.println("Running ReadATweet - Run #" + String(numRuns++));
    TembooChoreo HomeTimelineChoreo;
    
    
    // invoke the Temboo client.
    // NOTE that the client must be reinvoked, and repopulated with
    // appropriate arguments, each time its run() method is called.
    HomeTimelineChoreo.begin();
    
    // store the settings file in sda
    HomeTimelineChoreo.setSettingsFileToRead("/mnt/sda1/MyTwitterSettings");    

    // tell the Process to run and wait for the results. The 
    // return code will tell us whether the Temboo client 
    // was able to send our request to the Temboo servers
    unsigned int returnCode = HomeTimelineChoreo.run();
    
   // a response code of 0 means success; print the API response
    if(returnCode == 0) {
      
      String author; // a String to hold the tweet author's name
      String tweet; // a String to hold the text of the tweet


      // choreo outputs are returned as key/value pairs, delimited with 
      // newlines and record/field terminator characters, for example:
      // Name1\n\x1F
      // Value1\n\x1E
      // Name2\n\x1F
      // Value2\n\x1E      
      
      // see the examples at http://www.temboo.com/arduino for more details
      // we can read this format into separate variables, as follows:
      
      while(HomeTimelineChoreo.available()) {
        
        ledblue();
        
        // read the name of the output item
        String name = HomeTimelineChoreo.readStringUntil('\x1F');
        name.trim();

        // read the value of the output item
        String data = HomeTimelineChoreo.readStringUntil('\x1E');
        data.trim();

        // assign the value to the appropriate String
        if (name == "tweet") {
          tweet = data;
        } else if (name == "author") {
          author = data;
        }
      }
     
      //Serial.println("@" + author + " - " + tweet);
      delay(200);

      tweet.toCharArray(tweetchar, sizeof(tweetchar));  
              if (strcmp(tweetchar,tweetchar_old) == 0) {
                ledgreen();
                delay(100);
      	      }
              else {
              rotate();
	      SeeedOled.clearDisplay();
              SeeedOled.setHorizontalMode();
	      SeeedOled.putString(tweetchar);
	      delay(5000);	             
              //Serial.println(tweetchar);
              //Serial.println(tweetchar_old);         
              tweet.toCharArray(tweetchar_old, sizeof(tweetchar_old));
              }

        
    } else {
      // there was an error
      // print the raw output from the choreo
      while(HomeTimelineChoreo.available()) {
        char c = HomeTimelineChoreo.read();
        //Serial.print(c);
        
        SeeedOled.clearDisplay();
        SeeedOled.setPageMode();  
        SeeedOled.setTextXY(3,0);    
        SeeedOled.putString("   errore   ");
        ledred();
        
      }
    }

    HomeTimelineChoreo.close();

  }

  //Serial.println("Waiting...");
  ledgreen();
  SeeedOled.clearDisplay();
  SeeedOled.setTextXY(3,0);
  SeeedOled.putString("***************");  
  SeeedOled.setTextXY(4,0);
  SeeedOled.putString("***************");
  SeeedOled.setTextXY(6,0);
  SeeedOled.putString("waiting...45secs");   
  delay(45000); // wait 90 seconds between HomeTimeline calls  
}


// **************************** ****************************  ****************************

void rotate(){
  
  for(pos = 90; pos <= 130; pos += 1)  {
  ledred();    
  servo.write(pos);           
  delay(slow);                    
  } 
 
  for(pos = 130; pos>=40; pos-=1){
  ledblue();    
  servo.write(pos);         
  delay(fast);            
  }
 
  for(pos = 40; pos <= 90; pos += 1)  {
  ledred();
  servo.write(pos);           
  delay(slow);                    
  }

  servo.write(90);
  delay(100);
}

// **************************** ****************************  ****************************

void ledred(){
  digitalWrite(led_blue, LOW);
  digitalWrite(led_green, LOW);
  digitalWrite(led_red, HIGH);
}

void ledblue(){
  digitalWrite(led_blue, HIGH);
  digitalWrite(led_green, LOW);
  digitalWrite(led_red, LOW);  
}

void ledgreen(){
  digitalWrite(led_blue, LOW);
  digitalWrite(led_green, HIGH);
  digitalWrite(led_red, LOW);  
}

void ledoff(){
    digitalWrite(led_blue, LOW);
  digitalWrite(led_green, LOW);
  digitalWrite(led_red, LOW);  
}
