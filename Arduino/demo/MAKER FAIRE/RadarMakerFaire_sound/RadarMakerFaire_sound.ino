/*

it moves to 0-180 and back
misure distance
if distance is less then xx
it stops, souns Star Wars and writes a message on screen

*/

// star wars 
const int c = 261;
const int d = 294;
const int e = 329;
const int f = 349;
const int g = 391;
const int gS = 415;
const int a = 440;
const int aS = 455;
const int b = 466;
const int cH = 523;
const int cSH = 554;
const int dH = 587;
const int dSH = 622;
const int eH = 659;
const int fH = 698;
const int fSH = 740;
const int gH = 784;
const int gSH = 830;
const int aH = 880;
const int buzzerPin = 11;
const int ledPin1 = 9;
const int ledPin2 = 13;
int counter = 0;


//display
#include <Wire.h>
#include <SeeedOLED.h>
#include <avr/pgmspace.h>

const int buzzer = 11;
const int led_blue = 9;
const int led_green = 10;
const int led_red = 13;

#include <NewPing.h>
#include <Servo.h> 

#define TRIGGER_PIN  7 
#define ECHO_PIN     4 
#define MAX_DISTANCE 100 // Maximum distance we want to ping for (in centimeters). Maximum sensor distance is rated at 400-500cm.
#define SERVO_PWM_PIN 8         
NewPing sonar(TRIGGER_PIN, ECHO_PIN, MAX_DISTANCE); 

// means -angle .. angle
#define ANGLE_BOUNDS 80 // originale 80 !!!!!!!!!!!!!!!!!!!!!!!!!!!!!!
#define ANGLE_STEP 1

Servo servo;
int pos = 0;
int angle = 0;
int dir = 1; // direction of servo movement  -1 = back, 1 = forward
const int slow = 4;
const int fast = 2;


// funzione per neutralizzare i falsi positivi isoltati
const int numReadings = 3; 
int readings[numReadings];                // the readings from the analog input
int index = 0;                  // the index of the current reading
int total = 0;                  // the running total
int cm_ignora_posit = 0;                // the cm_ignora_posit


static unsigned char mouth_zigzag[] PROGMEM ={
0x00, 0x00, 0x00, 0x00, 0x00, 0x00, 0x00, 0x00, 0x00, 0x00, 0x00, 0x00, 0x00, 0x00, 0x00, 0x00,
0x00, 0x00, 0x00, 0x00, 0x00, 0x00, 0x00, 0x00, 0x00, 0x00, 0x00, 0x00, 0x00, 0x00, 0x00, 0x00,
0x00, 0x00, 0x00, 0x00, 0x00, 0x00, 0x00, 0x00, 0x00, 0x00, 0x00, 0x00, 0x00, 0x00, 0x00, 0x00,
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0x00, 0x00, 0x00, 0x00, 0x00, 0x00, 0x00, 0x00, 0x00, 0x00, 0x00, 0x00, 0x00, 0x00, 0x00, 0x00
};


static unsigned char daje[] PROGMEM ={
0x00, 0x00, 0x00, 0x00, 0x00, 0x00, 0x00, 0x00, 0x00, 0x00, 0x00, 0x00, 0x00, 0x00, 0x00, 0x00,
0x00, 0x00, 0x00, 0x00, 0x00, 0x00, 0x00, 0x00, 0x00, 0x00, 0x00, 0x00, 0x00, 0x00, 0x00, 0x00,
0x00, 0x00, 0x00, 0x00, 0x00, 0x00, 0x00, 0x00, 0x00, 0x00, 0x00, 0x00, 0x00, 0x00, 0x00, 0x00,
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0x00, 0x00, 0x00, 0x00, 0x00, 0x00, 0x00, 0x00, 0x00, 0x00, 0x00, 0x00, 0x00, 0x00, 0x00, 0x00
};

void setup() {
  
  for (int thisReading = 0; thisReading < numReadings; thisReading++) // 0, 1, 2
   readings[thisReading] = 0;  
  
    //output
  pinMode(buzzer,OUTPUT);
  pinMode(led_blue, OUTPUT);
  pinMode(led_green, OUTPUT);
  pinMode(led_red, OUTPUT);
  ledred();
  
  //display
  Wire.begin();
  SeeedOled.init(); 
  SeeedOled.clearDisplay();
  SeeedOled.drawBitmap(mouth_zigzag,1024);
  delay(200);

  
  Serial.begin(9600); 
  
  // se attacco il servo, non funziona più la luce verde!!!!!!!!!!!!!!!
  servo.attach(SERVO_PWM_PIN);  
  delay(200);
  ledblue();
}

void loop() {
  
  // we must renormalize to positive values, because angle is from -ANGLE_BOUNDS .. ANGLE_BOUNDS
  // and servo value must be positive
  
  servo.write(angle + ANGLE_BOUNDS);
  
  // read distance from sensor and send to serial
  getDistanceAndSend2Serial(angle);
  
  ledgreen();
  analogWrite (buzzer, 0);
  
  // calculate angle
  if (angle >= ANGLE_BOUNDS || angle <= -ANGLE_BOUNDS) {
    dir = -dir;
  }
  angle += (dir * ANGLE_STEP);    
}


int getDistanceAndSend2Serial(int angle) {
  int cm = sonar.ping_cm();
  delay(15);


  readings[index] = cm;
  cm_ignora_posit = (readings[0] * readings[1] * readings[2]);
  index = index + 1;
  if (index>=numReadings)
	index = 0;

  Serial.print("cm: ");
  Serial.print(cm);
  Serial.print("cm ignora falsi: ");
  Serial.println(cm_ignora_posit);  

  if (cm_ignora_posit != 0) {
    
      //MKF
      if (cm < 6) {
        ledred();
        SeeedOled.drawBitmap(daje,1024);
        secondSection();
        firstSection();
        delay(1000);
        SeeedOled.drawBitmap(mouth_zigzag,1024);
      }
         
      ledblue();
      int pitch = map(cm, 0, 99, 50, 0);  // 50 per avere n tono piezo non fastidioso
      analogWrite (led_green, pitch * 5); // da 0 a 250
      analogWrite (buzzer, pitch);
      delay(10); 
    }  
}

// **************************** ****************************  ****************************

void ledred(){
  digitalWrite(led_blue, LOW);
  digitalWrite(led_green, LOW);
  digitalWrite(led_red, HIGH);
}

void ledblue(){
  digitalWrite(led_blue, HIGH);
  digitalWrite(led_green, LOW);
  digitalWrite(led_red, LOW);  
}

void ledgreen(){
  digitalWrite(led_blue, LOW);
  digitalWrite(led_green, HIGH);
  digitalWrite(led_red, LOW);  
}

void ledoff(){
  digitalWrite(led_blue, LOW);
  digitalWrite(led_green, LOW);
  digitalWrite(led_red, LOW);  
}


// **************************** ****************************  ****************************


void beep(int note, int duration)
{
  //Play tone on buzzerPin
  tone(buzzerPin, note, duration);
 
  //Play different LED depending on value of 'counter'
  if(counter % 2 == 0)
  {
    digitalWrite(ledPin1, HIGH);
    delay(duration);
    digitalWrite(ledPin1, LOW);
  }else
  {
    digitalWrite(ledPin2, HIGH);
    delay(duration);
    digitalWrite(ledPin2, LOW);
  }
 
  //Stop tone on buzzerPin
  noTone(buzzerPin);
 
  delay(50);
 
  //Increment counter
  counter++;
}
 
void firstSection()
{
  beep(a, 500);
  beep(a, 500);    
  beep(a, 500);
  beep(f, 350);
  beep(cH, 150);  
  beep(a, 500);
  beep(f, 350);
  beep(cH, 150);
  beep(a, 650);
 
  delay(500);
 
  beep(eH, 500);
  beep(eH, 500);
  beep(eH, 500);  
  beep(fH, 350);
  beep(cH, 150);
  beep(gS, 500);
  beep(f, 350);
  beep(cH, 150);
  beep(a, 650);
 
  delay(500);
}
 
void secondSection()
{
  beep(aH, 500);
  beep(a, 300);
  beep(a, 150);
  beep(aH, 500);
  beep(gSH, 325);
  beep(gH, 175);
  beep(fSH, 125);
  beep(fH, 125);    
  beep(fSH, 250);
 
  delay(325);
 
  beep(aS, 250);
  beep(dSH, 500);
  beep(dH, 325);  
  beep(cSH, 175);  
  beep(cH, 125);  
  beep(b, 125);  
  beep(cH, 250);  
 
  delay(350);

}


// ********************

// **************************** ****************************  ****************************

void rotate(){
  
  for(pos = 90; pos <= 130; pos += 1)  {
  ledred();    
  servo.write(pos);           
  delay(slow);                    
  } 
 
  for(pos = 130; pos>=40; pos-=1){
  ledblue();    
  servo.write(pos);         
  delay(fast);            
  }
 
  for(pos = 40; pos <= 80; pos += 1)  {
  ledred();
  servo.write(pos);           
  delay(slow);                    
  }
  
  for(pos = 80; pos <= 180; pos += 1)  {
  ledblue();    
  servo.write(pos);           
  delay(fast);                    
  }
 
  for(pos = 180; pos>=0; pos-=1){
  ledred();
  servo.write(pos);         
  delay(slow);            
  }
    
    
  for(pos = 0; pos <= 110; pos += 1)  {
  ledblue();    
  servo.write(pos);           
  delay(fast);                    
  } 
 
  for(pos = 110; pos>=0; pos-=1){  
  ledblue();    
  servo.write(pos);         
  delay(fast);            
  }
 
  for(pos = 0; pos <= 40; pos += 1)  {
  ledred();
  servo.write(pos);           
  delay(slow);                    
  }
  
  for(pos = 40; pos <= 150; pos += 1)  {  
  ledred();
  servo.write(pos);           
  delay(slow);                    
  }
 
  for(pos = 150; pos>=110; pos-=1){  
  ledblue();    
  servo.write(pos);         
  delay(fast);            
  }
  
  for(pos = 110; pos>=90; pos-=1){ 
  ledblue();    
  servo.write(pos);         
  delay(fast);            
  }  
  
  servo.write(90);
  delay(100);
}
