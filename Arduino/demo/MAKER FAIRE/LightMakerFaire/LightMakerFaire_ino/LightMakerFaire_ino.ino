/*
https://gist.github.com/biokys/6846527
https://learn.sparkfun.com/tutorials/connecting-arduino-to-processing/to-processing

Array to store data
http://arduino.cc/en/Reference/Array

http://arduino.cc/en/Tutorial/Smoothing

attenzione: possibile che sia necessario cambiare valore a: String portName = Serial.list()[3];
mello sketch di Processing

FARE
con certi oggetti-distanza rallenta la velocità di cicalio

NOTE

*/

//light theremin
int sensorValue;
int sensorValue2;
int sensorLow = 1023;
int sensorHigh = 0;

//display
#include <Wire.h>
#include <SeeedOLED.h>
#include <avr/pgmspace.h>

const int buzzer = 11;
const int led_blue = 9;
const int led_green = 10;
const int led_red = 13;

#include <NewPing.h>
#include <Servo.h> 


#define SERVO_PWM_PIN 8         

// means -angle .. angle
#define ANGLE_BOUNDS 80 // originale 80 !!!!!!!!!!!!!!!!!!!!!!!!!!!!!!
#define ANGLE_STEP 1

Servo myservo;
int angle = 0;
int dir = 1; // direction of servo movement  -1 = back, 1 = forward 


static unsigned char mouth_zigzag[] PROGMEM ={
0x00, 0x00, 0x00, 0x00, 0x00, 0x00, 0x00, 0x00, 0x00, 0x00, 0x00, 0x00, 0x00, 0x00, 0x00, 0x00,
0x00, 0x00, 0x00, 0x00, 0x00, 0x00, 0x00, 0x00, 0x00, 0x00, 0x00, 0x00, 0x00, 0x00, 0x00, 0x00,
0x00, 0x00, 0x00, 0x00, 0x00, 0x00, 0x00, 0x00, 0x00, 0x00, 0x00, 0x00, 0x00, 0x00, 0x00, 0x00,
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0x00, 0x00, 0x00, 0x00, 0x00, 0x00, 0x00, 0x00, 0x00, 0x00, 0x00, 0x00, 0x00, 0x00, 0x00, 0x00
};


static unsigned char daje[] PROGMEM ={
0x00, 0x00, 0x00, 0x00, 0x00, 0x00, 0x00, 0x00, 0x00, 0x00, 0x00, 0x00, 0x00, 0x00, 0x00, 0x00,
0x00, 0x00, 0x00, 0x00, 0x00, 0x00, 0x00, 0x00, 0x00, 0x00, 0x00, 0x00, 0x00, 0x00, 0x00, 0x00,
0x00, 0x00, 0x00, 0x00, 0x00, 0x00, 0x00, 0x00, 0x00, 0x00, 0x00, 0x00, 0x00, 0x00, 0x00, 0x00,
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0x00, 0x00, 0x00, 0x00, 0x00, 0x00, 0x00, 0x00, 0x00, 0x00, 0x00, 0x00, 0x00, 0x00, 0x00, 0x00
};

void setup() {
  
 
  //
    while (millis() < 5000) {
    sensorValue = analogRead(A5);
    if (sensorValue > sensorHigh) {
      sensorHigh = sensorValue;
    }
    if (sensorValue < sensorLow) {
      sensorLow = sensorValue;
    }
  }
  
  //output
  pinMode(buzzer,OUTPUT);
  pinMode(led_blue, OUTPUT);
  pinMode(led_green, OUTPUT);
  pinMode(led_red, OUTPUT);
  ledred();
  
  //display
  Wire.begin();
  SeeedOled.init(); 
  SeeedOled.clearDisplay();
  SeeedOled.drawBitmap(mouth_zigzag,1024);
  delay(200);

  Serial.begin(9600); 
  
  // se attacco il servo, non funziona più la luce verde!!!!!!!!!!!!!!!
  myservo.attach(SERVO_PWM_PIN);  
  delay(200);
  ledblue();
}

void loop() {
  
  // we must renormalize to positive values, because angle is from -ANGLE_BOUNDS .. ANGLE_BOUNDS
  // and servo value must be positive
  
  delay(30);
  
  myservo.write(angle + ANGLE_BOUNDS);
  
  ledgreen();
  
  Serial.println(sensorValue);

      sensorValue = analogRead(A5);
      sensorValue2 = analogRead(A4);      
      //int pitch = map((sensorValue+sensorValue2/2), sensorLow, sensorHigh, 4000, 5000);
      int pitch = map(sensorValue, sensorLow, sensorHigh, 400, 800);
      tone(11, pitch, 20);         
  
  // calculate angle
  if (angle >= ANGLE_BOUNDS || angle <= -ANGLE_BOUNDS) {
    dir = -dir;
  }
  angle += (dir * ANGLE_STEP);    
}


// **************************** ****************************  ****************************

void ledred(){
  digitalWrite(led_blue, LOW);
  digitalWrite(led_green, LOW);
  digitalWrite(led_red, HIGH);
}

void ledblue(){
  digitalWrite(led_blue, HIGH);
  digitalWrite(led_green, LOW);
  digitalWrite(led_red, LOW);  
}

void ledgreen(){
  digitalWrite(led_blue, LOW);
  digitalWrite(led_green, HIGH);
  digitalWrite(led_red, LOW);  
}

void ledoff(){
  digitalWrite(led_blue, LOW);
  digitalWrite(led_green, LOW);
  digitalWrite(led_red, LOW);  
}

// **************************** ****************************  ****************************

void voice(){
   for (int i=0; i <= 40; i++){
      sensorValue = analogRead(A5);
      int pitch = map(sensorValue, sensorLow, sensorHigh, 4000, 5000);
      tone(buzzer, pitch, 20);
      delay(10);      
      sensorValue = analogRead(A5);
      pitch = map(sensorValue, sensorLow, sensorHigh, 4000, 5000);
      tone(buzzer, pitch, 20);
      delay(10);   
    }      
}
